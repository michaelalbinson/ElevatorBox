#include <SPI.h>
#include <Wire.h>
#include <Adafruit_GFX.h>
#include <Adafruit_SSD1306.h>

#define OLED_RESET 4

#define RESET_BUTTON 12
#define INC_TEN 5
#define INC_ONE 3
#define BUZZER_PIN 9
#define DEC_TEN 10
#define DEC_ONE 11

Adafruit_SSD1306 display(OLED_RESET);

int dayCount = 0;

long fifthSecIntervalCount = 0;
boolean oneDayIncrementPushed = false;
boolean tenDayIncrementPushed = false;
boolean oneDayDecrementPushed = false;
boolean tenDayDecrementPushed = false;
boolean mainButtonPushed = false;

const unsigned char logo [] PROGMEM = { //http://javl.github.io/image2cpp/ is super useful for creating these bitmaps
0x00, 0x00, 0x00, 0x00, 0x00, 0x00, 0x00, 0x00, 0x00, 0x00, 0x00, 0x00, 0x00, 0x00, 0x00, 0x00, 
0x00, 0x00, 0x00, 0x00, 0x00, 0x00, 0x00, 0x00, 0x00, 0x00, 0x00, 0x00, 0x00, 0x00, 0x00, 0x00, 
0x00, 0x00, 0x00, 0x00, 0x00, 0x00, 0x00, 0x00, 0x00, 0x00, 0x00, 0x00, 0x00, 0x00, 0x00, 0x00, 
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0x00, 0x00, 0x00, 0x00, 0x00, 0x00, 0x00, 0x00, 0x00, 0x00, 0x00, 0x00, 0x00, 0x00, 0x00, 0x00
};


void setup() {
  Serial.begin(9600);
  initiatePins();
  displayWelcome();
  displayLogo();
  soundWelcome();
  setupFunction(false);
}

void loop() {
  delay(200);
  checkButtonPush();
  fifthSecIntervalCount++;
  if(fifthSecIntervalCount >= 431999) //(5fifthsec/sec)*(60sec/1 min)*(60mins/1hr)*(24hrs/1day)
    displayDate(true);
}

void checkButtonPush() {
  if (!digitalRead(RESET_BUTTON))
    return;
   
   fifthSecIntervalCount = 0;
   dayCount = 0;
   displayTextLineAndDelay(" ELEVATOR  FAILURE", 0, 2);
   elevatorFailureTone();
   setupFunction(true);
}

void setupFunction(boolean toDelay) {
  boolean setupComplete = false;
  boolean displayed = true;
  int count = 0;
  if (toDelay)
    delay(1000);
  
  while (!setupComplete) {
    if (digitalRead(RESET_BUTTON))
      setupComplete = true;
    else if (digitalRead(INC_TEN))
      incrementOrDecrementDayCount(1);
    else if (digitalRead(INC_ONE))
      incrementOrDecrementDayCount(10);
    else if (digitalRead(DEC_TEN))
      incrementOrDecrementDayCount(-1);
    else if (digitalRead(DEC_ONE))
      incrementOrDecrementDayCount(-10);
    delay(100);
    if(count >= 4){ 
      alternateDisplaying(displayed);
      displayed = !displayed;
      count = 0;
    }
    count++;
  }
  indicateSetupCompleteWithTone();
  displayDate(false);
}

void incrementOrDecrementDayCount(int countToChange) {
  if((dayCount + countToChange) <= 0)
    return;

  if((dayCount + countToChange) >= 9999)
    return; 

  dayCount += countToChange;
}

void initiatePins() {
  pinMode(BUZZER_PIN, OUTPUT);//buzzer
  pinMode(RESET_BUTTON, INPUT); //large reset button
  pinMode(INC_TEN, INPUT); //increment +1 button
  pinMode(INC_ONE, INPUT); //increment +10 button
  pinMode(DEC_TEN, INPUT); //decrement -1 button
  pinMode(DEC_ONE, INPUT); //decrement -10 button
}

void indicateSetupCompleteWithTone() {
  tone(BUZZER_PIN, 1000);
  delay(500);
  tone(BUZZER_PIN, 2000);
  delay(500);
  noTone(BUZZER_PIN);
}

void elevatorFailureTone() {
  tone(BUZZER_PIN, 500);
  delay(1000);
  noTone(BUZZER_PIN);
}

void soundWelcome() {
  tone(BUZZER_PIN, 262);
  delay(500);
  tone(BUZZER_PIN, 524);
  delay(500);
  noTone(BUZZER_PIN);
}

void displayWelcome(){
  display.begin(SSD1306_SWITCHCAPVCC, 0x3C); 
  display.setTextSize(2);
  display.setTextColor(WHITE);
  display.setCursor(10,0);
  display.clearDisplay();
  display.println("Welcome!");
  display.display();
  delay(2000);
}

void displayDate(boolean increment) {
  if (increment){
    dayCount++;
  }

  display.clearDisplay();
  display.setTextSize(4);
  display.setCursor(18,2);
  if (dayCount > 9999){
    displayTextLineAndDelay("ROLLOVER: DAY LIMIT REACHED", 2000, 1);
    displayTextLineAndDelay("Either you were asking for this", 2000, 1);
    displayTextLineAndDelay("Or it's been 27 years", 2000, 1);
    displayTextLineAndDelay("The latter of which", 2000, 1);
    displayTextLineAndDelay("would just be impressive", 2000, 1);
    displayTextLineAndDelay("resetting to zero", 2000, 1); 
    dayCount = 0;
  }
  else if (dayCount > 999)
    display.print(String(dayCount));
   else if (dayCount > 99)
     display.print("0" + String(dayCount));
   else if (dayCount > 9)
     display.print("00" + String(dayCount));
   else
     display.print("000" + String(dayCount));
  display.display();
  fifthSecIntervalCount = 0;
}

void displayTextLineAndDelay(String textLine, int delayTime, int displaySize) {
  display.clearDisplay();
  display.setTextSize(displaySize);
  display.setCursor(10,0);
  display.print(textLine);
  display.display();
  delay(delayTime);
}

void displayLogo(){
  display.clearDisplay();
  display.setCursor(0, 0);
  display.drawBitmap(0, 0, logo, 128, 32, 1);
  display.display();
  delay(5000);
}

void alternateDisplaying(boolean state){
  if (!state){
    display.clearDisplay(); 
    display.display();
    return;
  }
  displayDate(false);
}
